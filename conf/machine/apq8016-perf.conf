## conf/machine/apq8016-perf.conf
```bitbake
#@TYPE: Machine
#@NAME: APQ8016 Perf
#@DESCRIPTION: Machine configuration for QTI APQ8016 for perf.

BASEMACHINE = "apq8016"

include ${BASEMACHINE}.conf

MACHINEOVERRIDES = "${BASEMACHINE}:${MACHINE}"
```

## conf/machine/apq8016.conf
```bitbake
#@TYPE: Machine
#@NAME: APQ8016
#@DESCRIPTION: Machine configuration for QTI APQ8016


# Uncomment the following line to enable the hard floating point abi. Note that
# this breaks some binary libraries and 3D (neither of which ship with
# meta-yocto). For maximum compatibility, leave this disabled.
#DEFAULTTUNE ?= "cortexa8hf-neon"

require conf/machine/include/arm/arch-armv8.inc

MACHINE_DISPLAY_WIDTH_PIXELS = "480"
MACHINE_DISPLAY_HEIGHT_PIXELS = "640"

SERIAL_CONSOLE = "115200 ttyO2"

PREFERRED_PROVIDER_virtual/kernel ?= "linux-quic"

MACHINE_FEATURES += "kernel26"
MACHINE_FEATURES += "keyboard"

MACHINE_DTS_NAME = "apq8016-sbc"

MACHINE_KERNEL_BASE = "0x81C00000"
MACHINE_KERNEL_TAGS_OFFSET = "0x81900000"
PAGE_SIZE = '4096'

EXTRA_IMAGECMD_apq8016 = "-N 2048"

EXTRA_KERNEL_CMD_PARAMS = "root=/dev/mmcblk0p22 rootfstype=ext4 earlyprintk androidboot.bootdevice=7824900.sdhci"

# Sizes for EXT4 (in bytes)
SYSTEM_SIZE_EXT4 = "200000000"
USERDATA_SIZE_EXT4 = "2000000000"
CACHE_SIZE_EXT4 = "65536000"

# This is added to avoid FATAL:Kernel too old error during boot up
# Be default this is set to 3.14 in meta layer
OLDEST_KERNEL_aarch64 = "3.10"

True_Userdata = "1"

DISTRO_FEATURES_append=" selinux"
```
